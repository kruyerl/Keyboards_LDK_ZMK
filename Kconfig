## boards/shields/ldk_skeletor/Kconfig.defconfig
```kconfig
if SHIELD_LDK_SKELETOR_RIGHT

config ZMK_KEYBOARD_NAME 
  default "ldk_skeletor"

config ZMK_SPLIT_ROLE_CENTRAL
  default y

endif

if SHIELD_LDK_SKELETOR_LEFT || SHIELD_LDK_SKELETOR_RIGHT

config ZMK_SPLIT
  default y

endif
```
